## board/ti/am335x/Kconfig
```kconfig
if TARGET_AM335X_EVM

config SYS_BOARD
	default "am335x"

config SYS_VENDOR
	default "ti"

config SYS_SOC
	default "am33xx"

config SYS_CONFIG_NAME
	default "am335x_evm"

config NOR
	bool "Support for NOR flash"
	help
	  The AM335x SoC supports having a NOR flash connected to the GPMC.
	  In practice this is seen as a NOR flash module connected to the
	  "memory cape" for the BeagleBone family.

config KM_BBB_2x16_CHAR_LCD
	bool "Enable KM BBB Expansion board's 2x16 character LCD"
	default n
	help
	  This option will enable the 2x16 character LCD on the expansion
	  board for BeagleBone Black developed by Kernel Masters.

source "board/ti/common/Kconfig"

endif
```
